## layers/meta-local-mirror/conf/layer.conf
```bitbake
# We have a conf and classes directory, add to BBPATH
BBPATH .= ":${LAYERDIR}"

# We have recipes-* directories, add to BBFILES
BBFILES += "${LAYERDIR}/recipes-*/*/*.bb \
            ${LAYERDIR}/recipes-*/*/*.bbappend"

BBFILE_COLLECTIONS += "meta-local-mirror"
BBFILE_PATTERN_meta-local-mirror = "^${LAYERDIR}/"
BBFILE_PRIORITY_meta-local-mirror = "6"

LAYERDEPENDS_meta-local-mirror = "core"
LAYERSERIES_COMPAT_meta-local-mirror = "dunfell"
```
